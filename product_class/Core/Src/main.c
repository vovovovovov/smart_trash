/* USER CODE BEGIN Header */
/**
 ******************************************************************************
 * @file           : main.c
 * @brief          : Main program body
 ******************************************************************************
 * @attention
 *
 * Copyright (c) 2025 STMicroelectronics.
 * All rights reserved.
 *
 * This software is licensed under terms that can be found in the LICENSE file
 * in the root directory of this software component.
 * If no LICENSE file comes with this software, it is provided AS-IS.
 *
 ******************************************************************************
 */
/* USER CODE END Header */
/* Includes ------------------------------------------------------------------*/
#include "main.h"
#include "dma.h"
#include "i2c.h"
#include "tim.h"
#include "usart.h"
#include "usb_device.h"
#include "gpio.h"

/* Private includes ----------------------------------------------------------*/
/* USER CODE BEGIN Includes */
#include "headfile.h"

/* USER CODE END Includes */

/* Private typedef -----------------------------------------------------------*/
/* USER CODE BEGIN PTD */

/* USER CODE END PTD */

/* Private define ------------------------------------------------------------*/
/* USER CODE BEGIN PD */
/* USER CODE END PD */

/* Private macro -------------------------------------------------------------*/
/* USER CODE BEGIN PM */

/* USER CODE END PM */

/* Private variables ---------------------------------------------------------*/

/* USER CODE BEGIN PV */
unsigned char BMP1[] =
{
	0x00,0x03,0x05,0x09,0x11,0xFF,0x11,0x89,0x05,0xC3,0x00,0xE0,0x00,0xF0,0x00,0xF8,
	0x00,0x00,0x00,0x00,0x00,0x00,0x00,0x44,0x28,0xFF,0x11,0xAA,0x44,0x00,0x00,0x00,
	0x00,0x00,0x00,0x00,0x00,0x00,0x00,0x00,0x00,0x00,0x00,0x00,0x00,0x00,0x00,0x00,
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	0x80,0xFF,0x80,0xEE,0xEE,0xEE,0xF5,0xFB,0xFF,0x9C,0xBE,0xB6,0xB6,0x88,0xFF,0x00,/*"D:\DreamSpark\OLED\MP3_UI.bmp",0*/
};

unsigned char RX_USART_1[64];
uint16_t RX_USART_1_LEN;
uint16_t RX_FLAG;


uint8_t  myUsbRxData[64] = { 0 };   // 接收到的数据
uint16_t myUsbRxNum = 0;

uint8_t  Transmit_Data[64] = { 0 };
Connectivity_Protocal_Struct Receive_data;
Connectivity_Protocal_Struct Transmit_data;
/* USER CODE END PV */

/* Private function prototypes -----------------------------------------------*/
void SystemClock_Config(void);
/* USER CODE BEGIN PFP */

/* USER CODE END PFP */

/* Private user code ---------------------------------------------------------*/
/* USER CODE BEGIN 0 */
static void Delay(__IO uint32_t nCount)	 //简单的延时函数
{
	for(; nCount != 0; nCount--);
}

/* USER CODE END 0 */

/**
  * @brief  The application entry point.
  * @retval int
  */
int main(void)
{
  /* USER CODE BEGIN 1 */

  /* USER CODE END 1 */

  /* MCU Configuration--------------------------------------------------------*/

  /* Reset of all peripherals, Initializes the Flash interface and the Systick. */
  HAL_Init();

  /* USER CODE BEGIN Init */

  /* USER CODE END Init */

  /* Configure the system clock */
  SystemClock_Config();

  /* USER CODE BEGIN SysInit */

  /* USER CODE END SysInit */

  /* Initialize all configured peripherals */
  MX_GPIO_Init();
  MX_DMA_Init();
  MX_TIM2_Init();
  MX_TIM3_Init();
  MX_I2C2_Init();
  MX_USART1_UART_Init();
  MX_USB_DEVICE_Init();
  /* USER CODE BEGIN 2 */

  //	HAL_TIM_Base_Start_IT(&htim2);   // 定时器中断初始化，用于轮询(测试版，现在单位改了)
  HAL_TIM_Base_Start_IT(&htim2);
  HAL_TIM_IC_Start(&htim2,TIM_CHANNEL_2);
  HAL_TIM_IC_Start_IT(&htim2, TIM_CHANNEL_2);  // 通道二输入捕获，用于超声波

  //	HAL_TIM_PWM_Start(&htim3,TIM_CHANNEL_1);
  SG90_PWM_START(&SG90_TIM, SG90_TIM_CHANNEL);
	TB6612_SET_START(&TB6612_TIM, TB6612_TIM_CHANNEL_A);
	TB6612_SET_DIRECTION(TB6612_PORT_A, TB6612_UP);
	TB6612_SET(TB6612_PORT,TB6612_PORT_PIN,TB6612_WORK);
	
  uint16_t recv_degree = 0;
	
	// 温湿度传感器
	DHT11_Data_TypeDef DHT11_Data;
	DHT11_Init ();
	
	//oled
	/* 滴答定时器初始化 */
    Systick_Init();

    /* IIC引脚初始化 */
    IIC_GPIO_Config();

    /* OLED初始化 */
    OLED_Init();
		
		
		
  /* USER CODE END 2 */

  /* Infinite loop */
  /* USER CODE BEGIN WHILE */
  while (1)
  {
    /* USER CODE END WHILE */

    /* USER CODE BEGIN 3 */
//		Delay(0x1fffff);
//		if( DHT11_Read_TempAndHumidity ( & DHT11_Data ) == SUCCESS)
//		{
//			;
//		}			
//		else
//		{
//			;
//		} 
		OLED_Fill(0xFF); // 全屏点亮
		OLED_Fill(0x00); // 全屏灭

		for (uint8_t i = 0; i < 4; i++)
		{
				OLED_ShowCN(22 + i * 16, 0, i); // 测试显示中文
		}
		Delay_1ms(2000);                                          // 2s
		OLED_ShowStr(0, 3, (unsigned char *)"EmbedFire Elec", 1);  // 测试6*8字符
		OLED_ShowStr(0, 4, (unsigned char *)"Hello EmbedFire", 2); // 测试8*16字符
		Delay_1ms(2000);                                          // 2*100=200s
		OLED_CLS();                                               // 清屏
		OLED_OFF();                                               // 测试OLED休眠
		Delay_1ms(2000);                                          // 2s
		OLED_ON();                                                // 测试OLED休眠后唤醒
		OLED_DrawBMP(0, 0, 128, 8, (unsigned char *)BMP1);        // 测试BMP位图显示
		Delay_1ms(2000);  
		
//		beep_on();
//    	beep_off();
//			TB6612_SET_SPEED(&TB6612_TIM, TB6612_TIM_CHANNEL_A, 25);
//    while (recv_degree < 180)
//    {
//      recv_degree++;
//      SG90_PWM_CONTROL(&SG90_TIM, SG90_TIM_CHANNEL, recv_degree);
//      HAL_Delay(10);
//    }
//    while (recv_degree)
//    {
//      recv_degree--;
//      //			__HAL_TIM_SetCompare(&htim3,TIM_CHANNEL_1,rere);
//      SG90_PWM_CONTROL(&SG90_TIM, SG90_TIM_CHANNEL, recv_degree);
//      HAL_Delay(10);
//    }

//    Get_distance();
  }
  /* USER CODE END 3 */
}

/**
  * @brief System Clock Configuration
  * @retval None
  */
void SystemClock_Config(void)
{
  RCC_OscInitTypeDef RCC_OscInitStruct = {0};
  RCC_ClkInitTypeDef RCC_ClkInitStruct = {0};
  RCC_PeriphCLKInitTypeDef PeriphClkInit = {0};

  /** Initializes the RCC Oscillators according to the specified parameters
  * in the RCC_OscInitTypeDef structure.
  */
  RCC_OscInitStruct.OscillatorType = RCC_OSCILLATORTYPE_HSE;
  RCC_OscInitStruct.HSEState = RCC_HSE_ON;
  RCC_OscInitStruct.HSEPredivValue = RCC_HSE_PREDIV_DIV1;
  RCC_OscInitStruct.HSIState = RCC_HSI_ON;
  RCC_OscInitStruct.PLL.PLLState = RCC_PLL_ON;
  RCC_OscInitStruct.PLL.PLLSource = RCC_PLLSOURCE_HSE;
  RCC_OscInitStruct.PLL.PLLMUL = RCC_PLL_MUL9;
  if (HAL_RCC_OscConfig(&RCC_OscInitStruct) != HAL_OK)
  {
    Error_Handler();
  }

  /** Initializes the CPU, AHB and APB buses clocks
  */
  RCC_ClkInitStruct.ClockType = RCC_CLOCKTYPE_HCLK|RCC_CLOCKTYPE_SYSCLK
                              |RCC_CLOCKTYPE_PCLK1|RCC_CLOCKTYPE_PCLK2;
  RCC_ClkInitStruct.SYSCLKSource = RCC_SYSCLKSOURCE_PLLCLK;
  RCC_ClkInitStruct.AHBCLKDivider = RCC_SYSCLK_DIV1;
  RCC_ClkInitStruct.APB1CLKDivider = RCC_HCLK_DIV2;
  RCC_ClkInitStruct.APB2CLKDivider = RCC_HCLK_DIV1;

  if (HAL_RCC_ClockConfig(&RCC_ClkInitStruct, FLASH_LATENCY_2) != HAL_OK)
  {
    Error_Handler();
  }
  PeriphClkInit.PeriphClockSelection = RCC_PERIPHCLK_USB;
  PeriphClkInit.UsbClockSelection = RCC_USBCLKSOURCE_PLL;
  if (HAL_RCCEx_PeriphCLKConfig(&PeriphClkInit) != HAL_OK)
  {
    Error_Handler();
  }
}

/* USER CODE BEGIN 4 */

// 定时器中断回调函数（用于轮询器）这个需要修改一下定时器
// void HAL_TIM_PeriodElapsedCallback(TIM_HandleTypeDef *htim)
//{

//	if(htim == (&htim2))
//	{
////		OS_IT_RUN();
//	}
//
//}

/* USER CODE END 4 */

/**
  * @brief  This function is executed in case of error occurrence.
  * @retval None
  */
void Error_Handler(void)
{
  /* USER CODE BEGIN Error_Handler_Debug */
  /* User can add his own implementation to report the HAL error return state */
  __disable_irq();
  while (1)
  {
  }
  /* USER CODE END Error_Handler_Debug */
}

#ifdef  USE_FULL_ASSERT
/**
  * @brief  Reports the name of the source file and the source line number
  *         where the assert_param error has occurred.
  * @param  file: pointer to the source file name
  * @param  line: assert_param error line source number
  * @retval None
  */
void assert_failed(uint8_t *file, uint32_t line)
{
  /* USER CODE BEGIN 6 */
  /* User can add his own implementation to report the file name and line number,
     ex: printf("Wrong parameters value: file %s on line %d\r\n", file, line) */
  /* USER CODE END 6 */
}
#endif /* USE_FULL_ASSERT */
